## firmware/head-controller/components/head_link_transport/Kconfig
```kconfig
menu "NoiseBot inter-MCU SPI transport"

    config NB_INTER_MCU_SPI_ENABLED
        bool "Enable dual-MCU SPI transport on Freenove head"
        default n
        help
            Keep disabled until audio, servo, robot LEDs and body touch are
            physically moved to the Waveshare main and GPIO 1/2/14/41/42 are
            confirmed high impedance on the head.

endmenu
```

## firmware/head-controller/components/nb_head_camera_service/Kconfig
```kconfig
menu "NoiseBot head camera"

    config NB_HEAD_CAMERA_ENABLED
        bool "Enable DM4 head camera semantic receiver"
        default n
        help
            Enables only the semantic command/event round trip
            (nb_camera_protocol). The DVP driver and OV2640 GPIO remain
            deferred until the DM4 hardware gate.

    config NB_HEAD_CAMERA_HW_ENABLED
        bool "Enable physical OV2640 DVP camera on head"
        depends on NB_HEAD_CAMERA_ENABLED
        select CAMERA_OV2640
        default n
        help
            Initializes the esp_video/V4L2 DVP backend on the Freenove's own
            pins (NB_HEAD_PIN_CAM_*) and the I2C/SCCB bus. Enable only after
            the DM4 electrical/bring-up gate. The regular DM4 semantic
            profile keeps this disabled.

endmenu
```

## firmware/head-controller/components/nb_head_display_service/Kconfig
```kconfig
menu "NoiseBot head display"

    config NB_HEAD_DISPLAY_ENABLED
        bool "Enable DM2 head display service"
        default n
        help
            Enables only the semantic receiver and capability advertisement.
            LovyanGFX and physical display GPIO remain deferred until the DM2
            hardware gate.

    config NB_HEAD_DISPLAY_HW_ENABLED
        bool "Enable physical ST7789 display on head"
        depends on NB_HEAD_DISPLAY_ENABLED
        default n
        help
            Initializes LovyanGFX on SPI2 using GPIO47 SCLK, GPIO21 MOSI and
            GPIO45 DC. Enable only after the DM2 electrical gate. The regular
            DM2 semantic profile keeps this disabled.

endmenu
```

## firmware/head-controller/sdkconfig.defaults
```kconfig
CONFIG_IDF_TARGET="esp32s3"
CONFIG_COMPILER_OPTIMIZATION_PERF=y
CONFIG_ESP_DEFAULT_CPU_FREQ_MHZ_240=y
CONFIG_ESPTOOLPY_FLASHSIZE_16MB=y
CONFIG_ESPTOOLPY_FLASHMODE_QIO=y
CONFIG_ESPTOOLPY_FLASHFREQ_80M=y
CONFIG_SPIRAM=y
CONFIG_SPIRAM_MODE_OCT=y
CONFIG_SPIRAM_SPEED_80M=y
CONFIG_SPIRAM_USE_MALLOC=y
CONFIG_ESP_TASK_WDT_EN=y
CONFIG_ESP_TASK_WDT_PANIC=y
CONFIG_ESP_BROWNOUT_DET=y
```

## firmware/main-controller/components/head_link_transport/Kconfig
```kconfig
menu "NoiseBot inter-MCU SPI transport"

    config NB_INTER_MCU_SPI_ENABLED
        bool "Enable dual-MCU SPI transport on Waveshare main"
        default n
        help
            Keep disabled until the N32R16V board variant is confirmed in
            bench, the Freenove legacy peripherals are rewired, and GPIO
            1/2/14/41/42 on the head are proven high impedance.

    config NB_DM1_BENCH_PROFILE
        bool "Boot main as minimal DM1 bench firmware"
        depends on NB_INTER_MCU_SPI_ENABLED
        default n
        help
            Bypass the legacy monolithic boot and initialize only the
            inter-MCU link task. Use only with the isolated build-dm1 profile.

    config NB_DM1_HEAD_RESET_PROBE
        bool "Run one-shot HEAD_RESET bench probe"
        depends on NB_DM1_BENCH_PROFILE
        default n
        help
            After the link reaches READY, pulse HEAD_RESET once and immediately
            request a second reset to validate the 10-second rate limit. Enable
            only in the isolated build-e6 profile with GPIO8 wired to head EN.

endmenu
```

## firmware/main-controller/components/services/conductor/Kconfig
```kconfig
menu "NoiseBot Conductor"

config NB_SD_SCORES
    bool "Carregar partituras do conductor do SD card"
    default n
    help
        Ativa carregamento de partituras de /sdcard/scores/ no boot.
        Apenas 1 ação por vez é sobrescrita (a primeira encontrada no SD).
        Destina-se a iteração de animações sem reflash.

        Formato de arquivo: /sdcard/scores/<action_idx>_<var>.txt
        Uma linha por step; campos separados por espaço:
          offset_ms expr_id expr_ms expr_play expr_dur motion_id motion_ms audio

        audio: caminho completo (/sdcard/...) ou "-" para silêncio.
        expr_id/motion_id: valores numéricos dos enums nb_expression_t/cond_motion_t.
        Se nenhum arquivo for encontrado, as partituras da ROM são usadas.

endmenu
```

## firmware/main-controller/main/Kconfig.projbuild
```kconfig
menu "NoiseBot"

    choice NB_BOARD_PROFILE
        prompt "NoiseBot board profile"
        default NB_BOARD_PROFILE_LEGACY
        help
            Selects the board profile explicitly in Kconfig/build. Legacy keeps
            the current Freenove-first mapping. Waveshare selects the target
            main-controller profile and disables the head-local HALs in this
            cut.

        config NB_BOARD_PROFILE_LEGACY
            bool "Legacy Freenove"

        config NB_BOARD_PROFILE_WAVESHARE
            bool "Waveshare main"

    endchoice

    menu "Audio"

        config NB_BOARD_HAS_AUDIO_REFERENCE
            bool "Board has clean speaker reference input"
            default n
            help
                Enable only on hardware with a real, clean speaker reference
                channel wired into the audio input path. The current NoiseBot
                board uses INMP441 + MAX98357A without that reference path.

        config NB_USE_DEVICE_AEC
            bool "Enable device-side AEC"
            default n
            depends on NB_BOARD_HAS_AUDIO_REFERENCE
            help
                Device-side AEC requires a clean output reference path from the
                speaker signal plus acoustic isolation. Keep disabled on the
                current mono-mic/no-reference hardware profile.

    endmenu

    menu "Camera"

        config NB_CAMERA_DIAG_ENABLED
            bool "Enable OV2640 camera path"
            default y
            help
                Enables the OV2640 capture path through esp_video/V4L2.

                The camera service keeps capture on demand and uses a short
                hot session to avoid repeated driver churn while preserving the
                robot's WiFi, SD and audio headroom.

    endmenu

endmenu
```

## main/Kconfig.projbuild
```kconfig
menu "NoiseBot"

    menu "Audio"

        config NB_BOARD_HAS_AUDIO_REFERENCE
            bool "Board has clean speaker reference input"
            default n
            help
                Enable only on hardware with a real, clean speaker reference
                channel wired into the audio input path. The current NoiseBot
                board uses INMP441 + MAX98357A without that reference path.

        config NB_USE_DEVICE_AEC
            bool "Enable device-side AEC"
            default n
            depends on NB_BOARD_HAS_AUDIO_REFERENCE
            help
                Device-side AEC requires a clean output reference path from the
                speaker signal plus acoustic isolation. Keep disabled on the
                current mono-mic/no-reference hardware profile.

    endmenu

    menu "Camera"

        config NB_CAMERA_DIAG_ENABLED
            bool "Enable OV2640 camera path"
            default y
            help
                Enables the OV2640 capture path through esp_video/V4L2.

                The camera service keeps capture on demand and uses a short
                hot session to avoid repeated driver churn while preserving the
                robot's WiFi, SD and audio headroom.

    endmenu

endmenu
```
